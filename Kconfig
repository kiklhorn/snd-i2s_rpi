## Kconfig
```kconfig
config SND_I2S_RPI
	tristate "I2S MEMs microphone"
	select NLS
	help
	  This adds support for the SPH0645LM4H I2S soundcard.

config SND_I2S_RPI_DEBUG_MSG
	bool "print debug messages"
	depends on SND_I2S_RPI
	default n
```
